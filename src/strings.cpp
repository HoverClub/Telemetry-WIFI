// file containing strings used by telemetry code

// NOTE - most of this stuff could be moved to the file system rather than prog memory to save space

// NOTE - if using a template processor for HTML make sure that % are doubled %% as they are used to recognise replacements!!!



#include <pgmspace.h>


// index.html for webserver v1.1 HTML supporting chunked transfers for logging!
const char index_html[] PROGMEM = R"rawliteral(
<!DOCTYPE HTML>
<html xmlns="http://www.w3.org/1999/xhtml" lang="en">
	<head>
	<meta charset="utf-8"/>
	<meta name=viewport content="width=device-width, initial-scale=1" >
	<link rel="icon" href="data:,">
	<title>Hovercraft Telemetry system</title>
	<style>
    html {font-family: Arial; display: inline-block; }
    p { font-size: 1.1rem;}
    body {margin: 0;}
		progress{margin: 0 10px 6px 10px;background-color:lightgrey;border-radius: 4px;box-shadow: 0 3px 6px;}
    .center {text-align: center;}
		.topnav { overflow: hidden; background-color: #50B8B4; color: white; font-size: 1rem;}
    .content { padding: 10px; }
		.heading {font-size:1em;letter-spacing: .5px;font-weight:bold;text-align: center;}
		#pthrust{ width: 380px;height: 20px;border: 3px solid #0cc;border-radius: 10px;}
		.button {background-color:gray;margin:8px;border:none;border-radius:5px;color:white;padding:10px 30px;text-align:center;text-decoration:none;display:inline-block;font-size: 16px;cursor: pointer;font-family: Sans;}
		.button:hover{background-color:slategray;}
		.ct-series-a .ct-line, .ct-series-a .ct-point {stroke: blue;stroke-width:2px;}
		.ct-series-b .ct-line, .ct-series-b .ct-point {stroke: green;stroke-width:2px;}
		.ct-series-c .ct-line, .ct-series-c .ct-point {stroke: red;stroke-width:2px;}
		.himg {vertical-align:middle;margin: 5px 30px;}
		.timg {display: inline-block;vertical-align:middle;width:195px;margin: 5px 30px;}
	</style>
	</head>
	<body>
		<div class="topnav center">
			<h1>Hovercraft Telemetry System</h1>
		</div>

		<form enctype="multipart/form-data" action="" method="post">
			<div class="content">
				<div style="font-size: small"><span id="debug1"></span><br/><span id="debug2"></span><br/><span id="debug3"></span></div>
				<p style="font-size: small">v2.9  &#169; John Robertson 2022</p>			
				<div id="cal" class="heading" style="display:none;">Please wait, calibrating <span id="stype"></span> ...</div>
				<div id="all" class="center">
					<div>
						<div style="display:inline-block;vertical-align: top;">
	<!-- 	
	Safari stops execution on the page when a file download is started - this fixes it by redirecting to home AFTER the download req. 
	If we redirect immediately, the download req may not have been ack'ed so a delay is used (user will be confirming the	download!) 
	
	This works in Safari but adds a 4sec delay - AND if the user hasn't elected to save the file before the delay expires the download is aborted !!!
		<a class="button" style="background-color:green;" id="logon" download onclick="location.assign('/logon'); setTimeout(function(){location.assign('http://10.1.1.1');}, 4000) ;return false;">Start Logging</a>

	This detects Safari and adds the redirect if needed
		<a class="button" style="background-color:green;" id="logon" download onclick="location.assign('/logon'); if (navigator.userAgent.indexOf('Safari') != -1 ) {setTimeout(function(){location.assign('http://10.1.1.1');}, 4000)} ;return false;">Start Logging</a>

	Works in newer Chrome and Firefox, etc. and is simple! - look at logon.onclick javascrip function below to see how it's handled for Safari!
		<a href="/logon" class="button" style="background-color:green;" id="logon" download >Start Logging</a>

	This usees the href to navigate nowhere AFTER the file download has been started by the javascript - doesn't work on Safari
		<a href="#0" class="button" style="background-color:green;" id="logon" download onclick="location.assign('/logon');">Start Logging</a>
	
	-->
							<a class="button" style="background-color:green;" id="logon" href="/logon" download>Start Logging</a>
							
							<button class="button" type="submit" style="background-color:red;display:none;" id="logoff" name="logoff">Stop Logging</button>
						</div>
						<div style="display:inline-block;vertical-align:top;font-size:small;">
							<div id="cam" style="display:none;">
								<div style="display:block;">
									<span>Camera space avail.</span><span id="cammem"></span>GB<br>
								</div>
								<div style="display:block;">
									<span>Battery:</span><span id="cambat"></span>%<br>
								</div>
								<div style="display:block;">
									<span id="vidfile"></span><br>
								</div>
							</div>
							<div style="display:block;">
								GPS is <span id="gps"></span>
							</div>
						</div>
						<div style="display:inline-block;vertical-align: top;font-size:small;display:none;" id="logtime">
							Log time <span id="ltime"></span>
						</div>
					</div>
					<div id="hide">
						<div id="thrust" class="heading" style="display: none;">
							<div>
								<span id="thrustval"></span>lbf
							</div>
							<meter id="pthrust" value="0" max="450"></meter>
						</div>
						<div class="center">
							<div id="caption" style="font-size:1.5em; margin:10px; text-align:center;"></div>
							<svg id="chart" style="width:800px;height:400px;" viewBox="0 0 800 400" xmlns="http://www.w3.org/2000/svg">
								<g id="chart-data"></g>
							</svg>
							<div id="legend" style="font-size:1em; margin:10px; text-align:center;"></div>
							<div>Tap chart to pause</div>
						</div>
						<div>
							<button class="button" id="pchart">Pause chart</button>
							<button type="submit" class="button" name="pcal">Calibrate Press.</button>
							<button type="submit" class="button" name="acal">Calibrate Accel.</button>
							<button type="submit" class="button" style="background-color:red;" name="rst" onclick="return confirm('Are you sure you want to reset the system?');">System Reset</button>
							<button type="submit" class="button" style="background-color:blue;" name="about">About</button>
						</div>
						<div>
							<span id="rollt" style="width:100px;" class="timg"></span>
							<span id="pitcht" class="timg"></span>
							<span id="yawt" class="timg"></span>
						</div>
						<div>
							<img id="roll" class="himg" style="transform: rotate(0deg);" src="hover_rear.png" alt="hover_rear"/>
							<img id="pitch" class="himg" style="transform: rotate(0deg);" src="hover_side.png" alt="hover_side" />
							<img id="yaw" class="himg" style="transform: rotate(0deg);" src="hover_top.png" alt="hover_top" />
						</div>
					</div>
				</div>
			</div>
		</form>
		
		<script>

			window.onpageshow = function(event) {
					if (event.persisted) {
							window.location.reload() 
					}
			};

			var debug = false; // set true to show SSE data on page
			var paused = false;
	
			// html elements
			var cal = document.getElementById("cal");
			var stype = document.getElementById("stype");
			var all = document.getElementById("all");
			var cam = document.getElementById("cam");
			var cambat = document.getElementById("cambat");
			var cammem = document.getElementById("cammem");
			var vidfile = document.getElementById("vidfile");
			var gps = document.getElementById("gps");
			var hide = document.getElementById("hide");
			var logon = document.getElementById("logon");
			var logoff = document.getElementById("logoff");
			var ltime = document.getElementById("ltime");
			var thrust = document.getElementById("thrust");
			var thrustval = document.getElementById("thrustval");
			var pthrust = document.getElementById("pthrust");
			var pitch = document.getElementById("pitch");
			var roll = document.getElementById("roll");
			var yaw = document.getElementById("yaw");
			var tpitch = document.getElementById("tpitch");
			var troll = document.getElementById("troll");
			var tyaw = document.getElementById("tyaw");

			logon.onclick = function(){
				if ((navigator.userAgent.indexOf('Safari/') != -1) && (navigator.userAgent.indexOf('Chrome/') == -1) && (navigator.userAgent.indexOf('Chromium/') == -1) )  // if Safari
				{
					location.assign('/logon');
					setTimeout(function(){location.assign('http://10.1.1.1');}, 4000);	// 4 secs before reloading page!
					return false;
				}
				else
					return true; // do normal download for all other browsers
			}

			// CHART SETUP STUFF
			const minVal = -500; // min input value 
			const maxVal = 2000; // max input value
			const YtickStep = 250; // Y axis tick marker steps (in max/minVal units), 0 = no Y axis marks
			const XtickDiv = 4; // X axis tick marker divisor (0 = no marks, 1 = every data point, 2 = every 2nd point, etc.
			const title = 'Cushion Pressures (Pa)'; // title included in caption
			const maxSeriesLen = 128; // maximum points along Xaxis

			// 'Ycoord' stores the scaled data point heights
			// 'Xcoord' stores the X axis position for point set
			// graph types are 'line', 'point' or 'linepoint'
			// types, labels, colors and line widths for each series set by you!
			var data = {
					types: 		['line','line','line'],		// series type (line, point or linepoint
					labels: 	['Bag', 'Bow', 'Cushion'],// labels appear below graph
					colors: 	['red', 'green', 'blue'],	// line (and point) colors
					widths: 	[1, 1, 1], 								// line width in px (points are scaled to twice the line width)
					
					// data below here is used by code at runtime!
					Ycoord: 		[],		// set of arrays of X posn of each data point in each series ([Xseries0,Xseries1,Xseries2],[Xseries0,Xseries1,Xseries2], etc)  
					Xcoord:			[],		// array of Xpoints (left)
					
					markElement:[],		// array of markers for each point series
					markURL:		[],
				};

				
			const chart = document.getElementById("chart"); // main chart container
			const chartData = document.getElementById("chart-data"); // data series patch, etc

			const chartWidth = chart.style.width.replace(/\D/g,'');
			const chartHeight = chart.style.height.replace(/\D/g,'')
			const Xoffset = 50; // graph elements offset to right to make space for Y axis & labels
			const Xtick = (chartWidth - Xoffset) / maxSeriesLen; // scale X tick along chart width

			// to avoid multipication calc in script fill array with preset X axis step position
			data.Xcoord = Array(maxSeriesLen).fill().map((item, index) => (Math.round(index * Xtick)) + Xoffset);

			var seriesCount = data.types.length; // # of data series

			// make a marker for each series if required
			for (let series=0; series < seriesCount; series++)
			{
				data.markElement[series] = "";
				data.markURL[series] = "";
				if (data.types[series] == "linepoint" || data.types[series] == "point") // only if required!
				{
					let mwidth = data.widths[series];
					data.markElement[series] = `
				<marker id="mark${series}" viewBox="0 0 ${mwidth * 2} ${mwidth * 2}" refX="${mwidth}" refY="${mwidth}"
						 markerWidth="${mwidth * 2}" markerHeight="${mwidth * 2}">
					<circle id="circle${series}" cx="${mwidth}" cy="${mwidth}" r="${mwidth}" fill="${data.colors[series]}" />
					</marker>`;
					data.markURL[series] = `marker-mid="url(#mark${series})"`;
				}
			}

			// scale value to fit Y axis (0 - chartHeight) AND invert to make Y increase up screen instead of downscreen with svg
			const scale = function (num) { return (num - maxVal) * chartHeight / (minVal - maxVal)};

			let chartGridInner =`
				<g style="text-anchor: end;">`;
			// X axis
			if (YtickStep > 0)
			{ // Y axis
				for (let step = minVal; step < maxVal; step += YtickStep)
					chartGridInner += `
						<line x1="${Xoffset}" x2="${chartWidth}" y1="${scale(step)}" y2="${scale(step)}" stroke="lightgrey" stroke-width="1"></line>
						<text x="${Xoffset-8}" y="${scale(step)}">${step}</text>`;
			}
			if (XtickDiv > 0)
			{ // X axis
				for (let step = Xoffset; step < chartWidth; step += Xtick * XtickDiv)
					chartGridInner += `
						<line x1="${step}" x2="${step}" y1="0" y2="${chartHeight}" stroke="${step == Xoffset ? "grey" : "lightgrey"}" stroke-width="${step == Xoffset ? 3 : 1}"></line>
						`;
			}
			chart.insertAdjacentHTML("beforeend", chartGridInner + `
			</g>`);

			// add title above and legend below
			document.getElementById("caption").innerHTML = '<span>' + title + '</span>';
			var text = "";
			for (let i = 0; i < data.labels.length; i++)
				text += `<span style="color:${data.colors[i]};">&nbsp;${data.labels[i]} &#9608; </span>`;
			document.getElementById("legend").innerHTML = text + " Tap to pause.";


			// pass an array of values, one for each series in the chart
			// adds them to chart display removing the oldest if points>maxSeriesLen
			const addPoints = function(points)
			{
				var scaledPoints = points;
				
				// if too many points then remove the oldest first
				if (data.Ycoord.length >= maxSeriesLen) // too many points already?
					data.Ycoord.shift();// remove oldest point set at start of chart

				//add new points to data array
				while (scaledPoints.length < seriesCount)
					scaledPoints.push(0); // pad any missing series values with zero
				
				for (let i=0; i < seriesCount; i++)
					scaledPoints[i] = Math.round(scale(scaledPoints[i])); // next data point height
				data.Ycoord.push(scaledPoints); // add new chart values

				// add new path element to svg for each data series
				let allInnerElements = "";
				for (let series=0; series < seriesCount; series++)
				{
					if (data.types[series] == "point")
					{
						for (y = 1; y < data.Ycoord.length; y++)
							allInnerElements += `
					<circle id="circle${series}" cx="${data.Xcoord[y]}" cy="${data.Ycoord[y][series]}" r="${data.widths[series] * 2}" fill="${data.colors[series]}" />`;
					}
					else
					{
						// add line path
						allInnerElements += `${data.markElement[series]}
							<path ${data.markURL[series]} d="M${data.Xcoord[0]} ${data.Ycoord[0][series]} L`;
						for (y = 1; y < data.Ycoord.length; y++)
							allInnerElements += `${data.Xcoord[y]} ${data.Ycoord[y][series]} `;
						allInnerElements += `"  stroke="${data.colors[series]}" stroke-width="${data.widths[series]}" fill="none"/>
						`;
					}
				}
				chartData.textContent = ''; // allegedly the fastest way to remove all child elements!
				chartData.insertAdjacentHTML("beforeend", allInnerElements);
			}


      // SSE handler
			if(typeof(EventSource) !== "undefined") {
				// Server-sent events support!
				if (!!window.EventSource) {
					var source = new EventSource('/events');

					source.addEventListener('open', function(e) {
					console.log("Events Connected");
					}, false);

					source.addEventListener('error', function(e) {
						if (e.target.readyState != EventSource.OPEN)
							console.log("Events Disconnected");
					}, false);

					source.addEventListener('message', function(e) {
						console.log("message", e.data);
					}, false);

					source.addEventListener('error', function(e) {
						console.log("message", e.data);
					}, false);

					// data is returned as a comma delimited string
					// with status added to start sensor data
					source.addEventListener('data', function(e) 
						{
							var start = new Date().getTime();

							var lines = e.data.split('|'); // get csv lines to an array of lines
	
							for (let i=0; i < lines.length; i++)
							{
								if (lines[i].length == 0)
									continue; // empty line!
		
								if (debug) 
									document.getElementById("debug2").innerHTML = lines[i];
								
								var res = lines[i].split(","); // get csv to array

								// disable all event-based elements during calibration and thrust, chart, calibrate, 
								// download, delete, etc. during logging.
								// When calibrating, ESP only sends calMode.  When logging, only calmode, logmode, mem/freespace and timer are sent.
								// data string received:
								//
								// 		Idle:		"0, camBat, camMem, GPSstatus, thrust, lastVidFilename, logTime, bag, bow, cush pressure, accel_X, accel_Y, accel_Z, gps_lat, gps_long, gps_speed, gps_time
								//
								// 		Calibrating: 		"1 or 2,"
								//
								// 		Logging: "3, cambat, cammem, gpsStat, logtime"
								//
								// Mode: 0 = idle, 1 = Press cal, 2 = Accel cal, 3 = logging active
								// > 128 debug active (outputs extra info on page)
								
								var mode = parseInt(res[0], 10);
								if (mode >=128)
								{
									debug = true;
									mode = mode - 128;
								}
								else
										debug = false;
			
								if (mode == 1 || mode == 2) // calModes?
								{
									cal.style.display="block"; 
									stype.innerHTML = mode == 1 ? "Pressure Sensors" : "Accelerometer";
									all.style.display = "none"; // hide everything for now
								}
								else
								{
									cal.style.display="none"; 
									all.style.display = "block";

									if (res[1] == 0) // camera present?
										cam.style.display="none";
									else
									{
										cam.style.display="block";
										cambat.innerHTML = res[1];
										cammem.innerHTML = res[2];
										vidfile.innerHTML = (mode == 0 ? "Last file: " + res[5] : ""); // show flename at idle only
									}
									
									gps.innerHTML = res[3]==1 ? " active" : " not locked";
				
									if (mode == 3)			// logMode
									{
										hide.style.display = "none"; // hide chart and thrust stuff during logging
										logon.style.display = "none";
										logoff.style.display = "block";
										logtime.style.display = "block";
										var d, h, m, s;
										s = Math.floor(res[4] / 1000);
										m = Math.floor(s / 60);
										s = s % 60;
										h = Math.floor(m / 60);
										m = m % 60;
										d = Math.floor(h / 24);
										h = h % 24;
										h += d * 24;
										ltime.innerHTML = (h < 10 ? "0" + h : h) + ":" + (m < 10 ? "0" + m : m) + ":" + (s < 10 ? "0" + s : s);  // seconds expired
									}
									else // not logging so show chart and other buttons
									{
										hide.style.display = "block"; // show chart and thrust stuff again
										logon.style.display = "block";
										logoff.style.display = "none";
										logtime.style.display = "none";

										if (res[4] === "") // any thrust valid?
											thrust.style.display = "none";
										else
										{
											thrust.style.display = "block";
											thrustval.innerHTML = res[4];
											pthrust.value = parseFloat(res[4]);
										}

										// add new pressure values to chart arrays
										if (!paused) // don't update chart if paused
											addPoints([parseFloat(res[7]), parseFloat(res[8]), parseFloat(res[9])]);

										// update pitch roll rotation
										pitcht.innerHTML = res[10];
										rollt.innerHTML = res[11];
										yawt.innerHTML = (res[12] * -1);
										pitch.style.transform = "rotate(" + res[10] + "deg)";
										roll.style.transform = "rotate(" + res[11] + "deg)";
										yaw.style.transform = "rotate(" + (res[12] * -1) + "deg)";
									}
								}
							}
							if (debug)
								document.getElementById("debug3").innerHTML = "Chart update time: " + (new Date().getTime() - start) + " Ms";
						}
					, false);
				}
			} else {
					alert("Sorry - your Web Browser doesn\'t support server-sent-events ...");
			}  
			
			pchart.onclick = function(){  // pause chart scrolling
				return togglePause();
			};

			chart.onclick = function(){  // pause chart scrolling
				return togglePause();
			};
			
			togglePause = function(){
				paused = !paused;
				if (paused)
				{
					pchart.innerHTML = "Restart Chart";
					pchart.style.backgroundColor = "darkred";
				}	else {
					pchart.innerHTML = "Pause Chart";
					pchart.style.backgroundColor = "gray";
				}
				return false; // stop button posting form!
			};
	
		</script>
	</body>
</html>

)rawliteral";


const char reset_html[] PROGMEM = R"rawliteral(
<!DOCTYPE HTML>
<html xmlns="http://www.w3.org/1999/xhtml" lang="en">
	<head>
	<meta charset="utf-8"/>
	<meta name=viewport content="width=device-width, initial-scale=1" >
	<link rel="icon" href="data:,">
	<title>Hovercraft Telemetry system</title>
	<style>
    html {font-family: Arial; display: inline-block; }
    p { font-size: 1.1rem;}
    body {margin: 0;}
    .topnav { overflow: hidden; background-color: #50B8B4; color: white; font-size: 1rem; text-align: center;}
    .content { padding: 10px; }
		.heading {font-size:1em;letter-spacing: .5px;font-weight:bold;text-align:center;}
		.button {background-color:gray;margin:8px;border:none;border-radius:5px;color:white;padding:10px 30px;text-align:center;text-decoration:none;display:inline-block;font-size: 16px;cursor: pointer;font-family: Sans;}
	</style>
	</head>
	<body>
		<div class="topnav">
			<h1>Hovercraft Telemetry System</h1>
		</div>

		<div class="content">
			<p style="font-size: small">v2.5  &#169; John Robertson 2021<p>			
			<div class="heading" >Please wait, system resetting (can take 30 seconds).</div>
			<div id="res" class="heading" style="display:none;"> 
				<br/>Reset completed - reconnect WiFi now. <a href="http://10.1.1.1" class="button">Home</a>
			</div>
		</div>
		<script>
		window.setTimeout(function(){document.getElementById("res").style.display="block";}, 45000);
	</script>
	</body>
</html>
)rawliteral";


const char about_html[] PROGMEM = R"rawliteral(
<!DOCTYPE HTML>
<html xmlns="http://www.w3.org/1999/xhtml" lang="en">
	<head>
	<meta charset="utf-8"/>
	<meta name=viewport content="width=device-width, initial-scale=1" >
	<link rel="icon" href="data:,">
	<title>Hovercraft Telemetry system</title>
	<style>
    html {font-family: Arial; display: inline-block; }
    p { font-size: 1.1rem;}
    body {margin: 0;}
	  .center {text-align: center;}
		.topnav { overflow: hidden; background-color: #50B8B4; color: white; font-size: 1rem;}
    .content { padding: 10px; }
		.heading {font-size:1em;letter-spacing: .5px;font-weight:bold;text-align: center;}
		.button {background-color:gray;margin:8px;border:none;border-radius:5px;color:white;padding:10px 30px;text-align:center;text-decoration:none;display:inline-block;font-size: 16px;cursor: .button:hover{background-color:slategray;}
	</style>
	</head>
	<body>
		<div class="topnav center">
			<h1>Hovercraft Telemetry System</h1>
		</div>

		<div class="content">
			<div style="font-size: small"><span id="debug1"></span><br/><span id="debug2"></span><br/><span id="debug3"></span></div>
			<p style="font-size: small">v2.9  &#169; John Robertson 2022</p>			

			<p>This device supplies reaal time data via WiFi from various sensorsL: pressure (3 x MXPV67002 +/-2KPa sensors), XYZ accelerometer & gyro (MPU6050) and a GPS module.  Log data can be read (and saved) via this web page (download) OR via the USB serial interface (@ 115200baud).  Data sampling rate is 50Hz (0.3Hz on the serial interface).  An optional load cell can also be connected to read thrust - it isn't logged but displayed in real time.  Any of the connected devices (web page, serial port) can stream data independently.
			</p>

			<p>During calibration, logging is disabled on all devices - also make sure the unit box is flat (use the bubble level on top), oriented correctly (front, l/r, etc.) and that the pressure sensors are only subjected to ambient pressure!  Calibration values are saved between power cycles.</p>
			
			<p>The web page is available at IP address 10.1.1.1:80  This device also uses a TelNet port on 7878 to control an optional Xaomi Yi camera (video recording is turned on/off with Logging).  Note that the camera must be turned on and WiFi enabled (camera side button) BEFORE this device is powered up or reset (so it can connect to the camera).</p>
			
			<p>Data is CSV formattted:<br/>
			<i>  Sample time (mSec)<br>  Bow pressure (Pa)<br>  Bag<br>  Cushion<br>  Pitch (raw accelerometer value)<br>  Roll<br>  Yaw<br>  Latitude<br>  Longitude<br>  Speed (100ths of a knot)<br>  Time (HHMMSS)</i><br/>
			It can be uploaded and viewed interactively here: <a href="http://cirtech.co.uk/viewer/plotter.php">http://cirtech.co.uk/viewer/plotter.php</a></p>

			<div>
				<a href="http://10.1.1.1" class="button">Back</a>
			</div>
				
		</div>
	</body>
</html>
)rawliteral";


// text version of index.html sent via Serial
const char help[] PROGMEM = R"rawliteral(
		Hovercraft Telemetry v2.8
		-------------------------

(c) John Robertson 2021

This device supplies data via WiFi from sensors - pressure (3 x MXPV67002 2KPa 
sensors), XYZ accelerometer (MPU6050) and a GPS module.  Log data can be read 
(and saved) via this web page (download) OR via a USB serial interface 
(@ 115200baud).  Data sampling rate is 20Hz (0.3Hz on the serial interface).
An optional load cell can be connected to read thrust - not logged but 
displayed in real time.  Either of the connected devices (web page, serial 
port) can stream data independently.  Multiple WiFi devices can also stream
simultaneously.
	
Serial interface commands:
'L' Starts and stops logging
'P' Calibrates pressure sensor
'A' to calibrate accelerometer & gyro 
'D' to turn on/off Web debug info (also available at 10.1.1.1/?debug)
'?' to display help screen via USB
'R' to reset the system
' ' <space> show current sensor values

During calibration, logging is disabled on all devices - also make 
sure the unit box is flat (use the bubble level), oriented correctly and that 
the pressure sensors are only subjected to ambient pressure!  Calibration 
values are saved between power cycles.
			
The web page is available at IP address 10.1.1.1:80.  A TelNet port on 7878 is
used by this device to control an optional Xaomi Yi camera (video recording is 
automatically turned on/off when logging is started/stopped). Note that the 
camera must be turned on and WiFi enabled (side button) BEFORE this device is 
powered up or reset (so it can connect to the camera).
			
Data is CSV formattted:
	Sample time (mSec)
	Bow pressure (Pa)
	Bag  
	Cushion
	Pitch (raw accelerometer value)
	Roll  
	Yaw  
	Latitude  
	Longitude  
	Speed (in 100ths of a knot)
	Time (HHMMSS)

Data can be uploaded and viewed at http://cirtech.co.uk/viewer/plotter.php

)rawliteral";


const unsigned char hover_top[] = {
0x89, 0x50, 0x4E, 0x47, 0x0D, 0x0A, 0x1A, 0x0A, 0x00, 0x00, 0x00, 0x0D, 0x49, 0x48, 0x44, 0x52, 
0x00, 0x00, 0x00, 0xC3, 0x00, 0x00, 0x00, 0x50, 0x08, 0x03, 0x00, 0x00, 0x00, 0x93, 0x53, 0x31, 
0x75, 0x00, 0x00, 0x02, 0x5B, 0x50, 0x4C, 0x54, 0x45, 0x00, 0x00, 0x00, 0x7F, 0x7F, 0x7F, 0x47, 
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0x45, 0x4E, 0x44, 0xAE, 0x42, 0x60, 0x82
};
const int sizeof_hover_top = sizeof(hover_top);


const unsigned char hover_side[] {
0x89, 0x50, 0x4E, 0x47, 0x0D, 0x0A, 0x1A, 0x0A, 0x00, 0x00, 0x00, 0x0D, 0x49, 0x48, 0x44, 0x52, 
0x00, 0x00, 0x00, 0xC3, 0x00, 0x00, 0x00, 0x4F, 0x08, 0x03, 0x00, 0x00, 0x00, 0x61, 0xD3, 0x81, 
0x3B, 0x00, 0x00, 0x01, 0x98, 0x50, 0x4C, 0x54, 0x45, 0x00, 0x00, 0x00, 0xEA, 0xEA, 0xEA, 0xEE, 
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0x07, 0x00, 0x00, 0x00, 0x00, 0x49, 0x45, 0x4E, 0x44, 0xAE, 0x42, 0x60, 0x82
};
const int sizeof_hover_side = sizeof(hover_side);

const unsigned char hover_rear[] = {
	0x89, 0x50, 0x4E, 0x47, 0x0D, 0x0A, 0x1A, 0x0A, 0x00, 0x00, 0x00, 0x0D, 0x49, 0x48, 0x44, 0x52, 
0x00, 0x00, 0x00, 0x64, 0x00, 0x00, 0x00, 0x45, 0x08, 0x03, 0x00, 0x00, 0x00, 0x8B, 0xCC, 0xB3, 
0xF5, 0x00, 0x00, 0x01, 0xB6, 0x50, 0x4C, 0x54, 0x45, 0x00, 0x00, 0x00, 0xEA, 0xEA, 0xEA, 0xE9, 
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0x44, 0xAE, 0x42, 0x60, 0x82
};
const int sizeof_hover_rear = sizeof(hover_rear);
